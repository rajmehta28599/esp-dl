## examples/human_face_recognition_live/sdkconfig.defaults.esp32p4
```kconfig
CONFIG_IDF_TARGET="esp32p4"

# ---------------- Flash / partition ----------------
CONFIG_ESPTOOLPY_FLASHMODE_QIO=y
CONFIG_ESPTOOLPY_FLASHFREQ_80M=y
CONFIG_ESPTOOLPY_FLASHSIZE_16MB=y
CONFIG_PARTITION_TABLE_CUSTOM=y
CONFIG_PARTITION_TABLE_CUSTOM_FILENAME="partitions.csv"
CONFIG_PARTITION_TABLE_OFFSET=0x9000

# ---------------- CPU / cache ----------------
CONFIG_ESP_DEFAULT_CPU_FREQ_MHZ_360=y
CONFIG_CACHE_L2_CACHE_256KB=y
CONFIG_CACHE_L2_CACHE_LINE_128B=y
CONFIG_COMPILER_OPTIMIZATION_PERF=y

# ---------------- PSRAM (32MB, needed for camera/display/LVGL/model buffers) -------
CONFIG_SPIRAM=y
CONFIG_SPIRAM_MODE_HEX=y
CONFIG_SPIRAM_SPEED_200M=y
# Model+code run from PSRAM XIP. Measured: this is actually FASTER than flash execution here,
# because PSRAM (200MHz octal) out-bandwidths flash (80MHz QIO) for weight streaming. (Disabling
# XIP was tested and gave no speedup - the ~2x vs datasheet is preprocessing/alignment, not memory.)
CONFIG_SPIRAM_XIP_FROM_PSRAM=y
CONFIG_SPIRAM_BOOT_INIT=y
CONFIG_SPIRAM_USE_MALLOC=y
CONFIG_SPIRAM_MALLOC_RESERVE_INTERNAL=32768
CONFIG_ESP_SYSTEM_ALLOW_RTC_FAST_MEM_AS_HEAP=n
CONFIG_IDF_EXPERIMENTAL_FEATURES=y

# ---------------- FATFS (face database long file names) ----------------
CONFIG_FATFS_LFN_HEAP=y

# ---------------- SC2336 MIPI-CSI camera (CrowPanel 2MP module) ----------------
# Output 1024x600 @ 30fps to exactly match the LCD / canvas buffers.
CONFIG_CAMERA_SC2336=y
CONFIG_CAMERA_SC2336_AUTO_DETECT_MIPI_INTERFACE_SENSOR=y
CONFIG_CAMERA_SC2336_MIPI_RAW8_1024X600_30FPS=y
CONFIG_CAMERA_SC2336_MIPI_IF_FORMAT_INDEX_DEFAULT=11
CONFIG_CAMERA_XCLK_USE_ESP_CLOCK_ROUTER=y

# ---------------- esp_video pipeline (ISP -> RGB565) ----------------
CONFIG_ESP_VIDEO_ENABLE_ISP=y
CONFIG_ESP_VIDEO_ENABLE_DATA_PREPROCESSING=y
CONFIG_ESP_VIDEO_ENABLE_MIPI_CSI_VIDEO_DEVICE=y
CONFIG_ESP_VIDEO_ENABLE_ISP_VIDEO_DEVICE=y
CONFIG_ESP_VIDEO_ENABLE_ISP_PIPELINE_CONTROLLER=y
CONFIG_ESP_VIDEO_DISABLE_MIPI_CSI_DRIVER_BACKUP_BUFFER=y
CONFIG_ESP_VIDEO_ENABLE_SWAP_SHORT=y

# ---------------- LVGL 8.x (built from Kconfig, no manual lv_conf.h) ----------------
CONFIG_LV_CONF_SKIP=y
CONFIG_LV_COLOR_DEPTH_16=y
CONFIG_LV_USE_CANVAS=y
CONFIG_LV_USE_BTN=y
CONFIG_LV_USE_LABEL=y
CONFIG_LV_FONT_MONTSERRAT_14=y
CONFIG_LV_FONT_MONTSERRAT_16=y
CONFIG_LV_FONT_MONTSERRAT_20=y
CONFIG_LV_FONT_MONTSERRAT_24=y
CONFIG_LV_FONT_DEFAULT_MONTSERRAT_14=y
CONFIG_LV_USE_PERF_MONITOR=n

# ---------------- esp-dl: pack ALL face models for runtime switching (R&D bench) ----------------
# Detector: MSRMNP (default) + both ESPDet single-stage models.
CONFIG_FLASH_HUMAN_FACE_DETECT_MSRMNP_S8_V1=y
CONFIG_FLASH_ESPDET_PICO_224_224_FACE=y
CONFIG_FLASH_ESPDET_PICO_416_416_FACE=y
# Recognizer: MFN (default) + MBF.
CONFIG_FLASH_HUMAN_FACE_FEAT_MFN_S8_V1=y
CONFIG_FLASH_HUMAN_FACE_FEAT_MBF_S8_V1=y
```
